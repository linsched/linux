## arch/linsched/Kconfig
```kconfig
config SMP
	def_bool y

config SCHED_DEBUG
	def_bool y

config CC_OPTIMIZE_FOR_SIZE
	def_bool y

config GENERIC_BUG
	def_bool y

config EXTRA_FIRMWARE
	string
	default ""

config 64BIT
	def_bool y

config GENERIC_FIND_LAST_BIT
	def_bool y

config SPLIT_PTLOCK_CPUS
	int
	default 4

config GENERIC_CLOCKEVENTS_BUILD
	def_bool y

config GENERIC_CLOCKEVENTS_BROADCAST
	def_bool y

config GENERIC_HWEIGHT
	def_bool y

config TREE_RCU
	def_bool y

config FUTEX
	def_bool y

config EXPERIMENTAL
	def_bool y

config INIT_ENV_ARG_LIMIT
	int
	default 128

config HIGH_RES_TIMERS
	def_bool y

config GENERIC_CLOCKEVENTS
	def_bool y

config NO_HZ
	def_bool y

config GENERIC_FIND_FIRST_BIT
	def_bool y

config HZ
	int
	default 1000

config TICK_ONESHOT
	def_bool y

config GENERIC_CALIBRATE_DELAY
	def_bool y

config POSIX_MQUEUE
	def_bool y

config PRINTK
	def_bool y

config BUG
	def_bool y

config RWSEM_XCHGADD_ALGORITHM
	def_bool y

config RWSEM_GENERIC_SPINLOCK
	def_bool y

config FRAME_POINTER
	def_bool y

config DEBUG_INFO
	def_bool y

config CON_ZERO_CHAN
	string
	default "fd:0,fd:1"
config BITREVERSE
	def_bool y

config CGROUPS
	def_bool y

config CGROUP_SCHED
	def_bool y

config CGROUP_CPUACCT
	def_bool y

config FAIR_GROUP_SCHED
	def_bool y

config SCHEDSTATS
	def_bool y

config HAVE_UNSTABLE_SCHED_CLOCK
	def_bool y

config ARCH_HAS_CACHE_LINE_SIZE
	def_bool y

config NODES_SHIFT
	int
	default 9

config NR_CPUS
	int
	default 32

config RT_MUTEXES
	def_bool y

config PREEMPT_NONE
	def_bool y

config DEBUG_PREEMPT
	def_bool y

config DEBUG_LIST
	def_bool y

config SPARSEMEM_ALLOC_MEM_MAP_TOGETHER
	def_bool y

config SPARSEMEM_EXTREME
	def_bool y

config SPARSEMEM_MANUAL
	def_bool y

config SPARSEMEM_VMEMMAP
	def_bool y

config SPARSEMEM_VMEMMAP_ENABLE
	def_bool y

config NEED_PER_CPU_EMBED_FIRST_CHUNK
	def_bool y

config SCHED_SMT
	def_bool y

config NEED_PER_CPU_PAGE_FIRST_CHUNK
	def_bool y

config SCHED_MC
	def_bool y

config NUMA
	def_bool y

config HOTPLUG_CPU
	def_bool y

config STOP_MACHINE
	def_bool y

config BASE_SMALL
	def_bool y

config IPV6
	def_bool n

config ARCH_TASK_STRUCT_ALLOCATOR
	def_bool y

config ARCH_THREAD_INFO_ALLOCATOR
	def_bool y
```

## arch/linsched/defconfig
```kconfig
CONFIG_SMP=y
CONFIG_SCHED_DEBUG=y
CONFIG_CC_OPTIMIZE_FOR_SIZE=y
CONFIG_GENERIC_BUG=y
CONFIG_EXTRA_FIRMWARE ""
CONFIG_64BIT=y
CONFIG_GENERIC_FIND_LAST_BIT=y
CONFIG_SPLIT_PTLOCK_CPUS=4
CONFIG_GENERIC_CLOCKEVENTS_BUILD=y
CONFIG_GENERIC_CLOCKEVENTS_BROADCAST=y
CONFIG_GENERIC_HWEIGHT=y
CONFIG_TREE_RCU=y
CONFIG_FUTEX=y
CONFIG_EXPERIMENTAL=y
CONFIG_INIT_ENV_ARG_LIMIT=128
CONFIG_HIGH_RES_TIMERS=y
CONFIG_GENERIC_CLOCKEVENTS=y
CONFIG_NO_HZ=y
CONFIG_GENERIC_FIND_FIRST_BIT=y
CONFIG_HZ=1000
CONFIG_TICK_ONESHOT=y
CONFIG_GENERIC_CALIBRATE_DELAY=y
CONFIG_POSIX_MQUEUE=y
CONFIG_PRINTK=y
CONFIG_BUG=y
CONFIG_RWSEM_XCHGADD_ALGORITHM=y
CONFIG_RWSEM_GENERIC_SPINLOCK=y
CONFIG_FRAME_POINTER=y
CONFIG_DEBUG_INFO=y
CONFIG_CON_ZERO_CHAN="fd:0,fd:1"
CONFIG_BITREVERSE=y
CONFIG_CGROUPS=y
CONFIG_CGROUP_SCHED=y
CONFIG_CGROUP_CPUACCT=y
CONFIG_FAIR_GROUP_SCHED=y
CONFIG_SCHEDSTATS=y
CONFIG_HAVE_UNSTABLE_SCHED_CLOCK=y
CONFIG_ARCH_HAS_CACHE_LINE_SIZE=y
CONFIG_NODES_SHIFT=9
CONFIG_NR_CPUS=32
CONFIG_RT_MUTEXES=y
CONFIG_PREEMPT_NONE=y
CONFIG_DEBUG_PREEMPT=y
CONFIG_DEBUG_LIST=y
CONFIG_SPARSEMEM_ALLOC_MEM_MAP_TOGETHER=y
CONFIG_SPARSEMEM_EXTREME=y
CONFIG_SPARSEMEM_MANUAL=y
CONFIG_SPARSEMEM_VMEMMAP=y
CONFIG_SPARSEMEM_VMEMMAP_ENABLE=y
CONFIG_NEED_PER_CPU_EMBED_FIRST_CHUNK=y
CONFIG_SCHED_SMT=y
CONFIG_NEED_PER_CPU_PAGE_FIRST_CHUNK=y
CONFIG_SCHED_MC=y
CONFIG_NUMA=y
CONFIG_HOTPLUG_CPU=y
CONFIG_STOP_MACHINE=y
```
